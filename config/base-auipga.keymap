#include <behaviors.dtsi>
#include <behaviors/num_word.dtsi> // Requires zmk-auto-layer module.
#include <behaviors/unicode.dtsi> // Requires zmk-unicode module.
#include <zmk-helpers/helper.h> // Requires zmk-helpers module.
#include <zmk-helpers/unicode-chars/german.dtsi>
#include <zmk-helpers/unicode-chars/currency.dtsi>
#include <dt-bindings/zmk/keys.h>
#ifdef CONFIG_WIRELESS
  #include <dt-bindings/zmk/bt.h>
  #include <dt-bindings/zmk/outputs.h>
  #define _BT_SEL_KEYS_                                                        \
      &bt BT_SEL 0 &bt BT_SEL 1 &bt BT_SEL 2 &bt BT_SEL 3 &bt BT_CLR
#else
  #define _BT_SEL_KEYS_ &trans &trans &trans &trans &trans
#endif
#include "_private.dtsi"

#define DEF 0
#define NAV 1
#define FN 2
#define NUM 3
#define SYM 4
#define MOUSE 5
#define VIM_NAV 6
#define VIM_HJKL 7
#define VIM_WS 8
#define VIM_RS 9
#define VIM_PS 10

#define XXX &none
#define ___ &trans

/* Global defaults */

#define QUICK_TAP_MS 175

&sk {
  release-after-ms = <900>;
  quick-release;
};

&sl { // Allow sticky mods to chord across sticky layers.
  ignore-modifiers;
};

&lt {
  flavor = "balanced";
  tapping-term-ms = <200>;
  quick-tap-ms = <QUICK_TAP_MS>;
};

/* Homerow mods */

#define KEYS_L LT0 LT1 LT2 LT3 LT4 LM0 LM1 LM2 LM3 LM4 LB0 LB1 LB2 LB3 LB4
#define KEYS_R RT0 RT1 RT2 RT3 RT4 RM0 RM1 RM2 RM3 RM4 RB0 RB1 RB2 RB3 RB4
#ifndef LH2
  #define THUMBS LH1 LH0 RH0 RH1         // Thumbs on 34 keys.
#else
  #define THUMBS LH2 LH1 LH0 RH0 RH1 RH2 // Thumbs on 36+ keys.
#endif

#define MAKE_HRM(NAME, HOLD, TAP, TRIGGER_POS)                                 \
  ZMK_HOLD_TAP(NAME, bindings = <HOLD>, <TAP>; flavor = "balanced";            \
               tapping-term-ms = <280>; quick-tap-ms = <QUICK_TAP_MS>;         \
               require-prior-idle-ms = <150>; hold-trigger-on-release;         \
               hold-trigger-key-positions = <TRIGGER_POS>;)

MAKE_HRM(hml, &kp, &kp, KEYS_R THUMBS) // Left-hand HRMs.
MAKE_HRM(hmr, &kp, &kp, KEYS_L THUMBS) // Right-hand HRMs.

// Hack: Make HRM combos tap-only (cf, ZMK issue #544).
#define ZMK_COMBO_8(NAME, TAP, POS, LAYERS, COMBO_MS, IDLE_MS, HOLD, SIDE)     \
  MAKE_HRM(hm_combo_##NAME, &kp, TAP, SIDE THUMBS)                             \
  ZMK_COMBO_6(NAME, &hm_combo_##NAME HOLD 0, POS, LAYERS, COMBO_MS, IDLE_MS)

/* Combos, leader key sequences, mouse emulation */

#include "combos-auipga.dtsi" // Must be sourced after HRM-combo hack.
#include "leader.dtsi"
#include "mouse.dtsi"

/* Nav cluster */

// Trigger tap-action on all interrupts.
#define MT_CORE                                                                \
  flavor = "tap-preferred";                                                    \
  tapping-term-ms = <220>;                                                     \
  quick-tap-ms = <220>;                                                        \
  hold-trigger-key-positions = <0>;

&mt { MT_CORE };

ZMK_HOLD_TAP(mt_home, bindings = <&masked_home>, <&kp>; MT_CORE)
ZMK_HOLD_TAP(mt_end, bindings = <&masked_end>, <&kp>; MT_CORE)

#define NAV_LEFT  &mt_home 0   LEFT  // Tap: left  | Long-tap: start of line.
#define NAV_RIGHT &mt_end 0    RIGHT // Tap: right | Long-tap: end   of line.
#define NAV_UP    &mt LC(HOME) UP    // Tap: up    | Long-tap: start of doc.
#define NAV_DOWN  &mt LC(END)  DOWN  // Tap: down  | Long-tap: end   of doc.
#define NAV_BSPC  &mt LC(BSPC) BSPC  // Tap: bspc  | Long-tap: delete word bwd.
#define NAV_DEL   &mt LC(DEL)  DEL   // Tap: del   | Long-tap: delete word fwd.

// Mask CTRL on left/right hold to avoid accidental jumps to start/end of doc.
#define MASK_MODS(NAME, MODS, BINDING)                                         \
  ZMK_MOD_MORPH(NAME, bindings = <BINDING>, <BINDING>; mods = <MODS>;)

MASK_MODS(masked_home, (MOD_LCTL), &kp HOME)
MASK_MODS(masked_end,  (MOD_LCTL), &kp END)

/* Magic-shift & auto-layers */

// Tap: repeat after alpha, else sticky-shift |
// Shift + tap/ double-tap: caps-word | Hold: shift.
#define MAGIC_SHIFT &magic_shift LSHFT 0
ZMK_HOLD_TAP(magic_shift, bindings = <&kp>, <&magic_shift_tap>;
             flavor = "balanced"; tapping-term-ms = <200>;
             quick-tap-ms = <QUICK_TAP_MS>;)
ZMK_MOD_MORPH(magic_shift_tap, bindings = <&shift_repeat>, <&caps_word>;
              mods = <(MOD_LSFT)>;)
ZMK_ADAPTIVE_KEY(
    shift_repeat, bindings = <&sk LSHFT>;
    repeat {
      trigger-keys = <A B C D E F G H I J K L M N O P Q R S T U V W X Y Z>;
      bindings = <&key_repeat>;
      max-prior-idle-ms = <1200>;
      strict-modifiers;
    };)
&caps_word { // Mods deactivate caps-word, requires PR #1451. [TODO: rebase]
  /delete-property/ ignore-modifiers;
};

// Tap: num-word | double-tap: sticky num-layer | Hold: num-layer.
#define SMART_NUM &smart_num NUM 0
ZMK_HOLD_TAP(smart_num, bindings = <&mo>, <&num_dance>; flavor = "balanced";
             tapping-term-ms = <200>; quick-tap-ms = <QUICK_TAP_MS>;)
ZMK_TAP_DANCE(num_dance, bindings = <&num_word NUM>, <&sl NUM>;
              tapping-term-ms = <200>;)

// Smart-mouse, requires tri-state module.
ZMK_TRI_STATE(
    smart_mouse, bindings = <&tog MOUSE>, <&none>, <&tog MOUSE>;
    ignored-key-positions =
        <LT1 LT2 LH0 LH1 RT1 RT2 RT3 RM0 RM1 RM2 RM3 RM4 RB1 RB2 RB3 RH0 RH1>;
    ignored-layers = <MOUSE NAV FN>;)

/* Custom behaviors */

// Alt+Tab swapper, requires tri-state module.
ZMK_TRI_STATE(swapper, bindings = <&kt LALT>, <&kp TAB>, <&kt LALT>;
              ignored-key-positions = <LT2 RT2 RM1 RM2 RM3>;)

// Define mod-morph with a *single* mod trigger for less repetition.
#define SIMPLE_MORPH(NAME, MOD, BINDING1, BINDING2)                            \
  ZMK_MOD_MORPH(NAME, mods = <(MOD_L##MOD | MOD_R##MOD)>;                      \
                bindings = <BINDING1>, <BINDING2>;)

// Tap: comma | Shift + tap: semicolon | Ctrl + shift + tap: <.
SIMPLE_MORPH(comma_morph, SFT, &kp COMMA, &comma_inner_morph)
SIMPLE_MORPH(comma_inner_morph, CTL, &kp SEMICOLON, &kp LESS_THAN)

// Tap: dot | Shift + tap: colon | Ctrl + shift + tap: >.
SIMPLE_MORPH(dot_morph, SFT, &kp DOT, &dot_inner_morph)
SIMPLE_MORPH(dot_inner_morph, CTL, &kp COLON, &kp GREATER_THAN)

// Tap: qmark | Shift + tap: excl.
SIMPLE_MORPH(qexcl, SFT, &kp QMARK, &kp EXCL)

// Tap: left/right parenthesis | Shft + tap: less-than/greater-than.
SIMPLE_MORPH(lpar_lt, SFT, &kp LPAR, &kp LT)
SIMPLE_MORPH(rpar_gt, SFT, &kp RPAR, &kp GT)

// Tap: space | Shift + tap: dot -> space -> sticky shift | Hold: nav layer.
ZMK_HOLD_TAP(lt_spc, bindings = <&mo>, <&spc_morph>; flavor = "balanced";
             tapping-term-ms = <200>; quick-tap-ms = <QUICK_TAP_MS>;)
SIMPLE_MORPH(spc_morph, SFT, &kp SPACE, &dot_spc)
ZMK_MACRO(dot_spc, bindings = <&kp DOT &kp SPACE &sk LSHFT>; wait-ms = <0>;
          tap-ms = <5>;)

// Tap: backspace | Lshft + tap: delete | Rshft + tap: shift-delete.
ZMK_MOD_MORPH(bs_del, bindings = <&kp BSPC>, <&kp DEL>;
              mods = <(MOD_LSFT|MOD_RSFT)>; keep-mods = <MOD_RSFT>;)

// Tap: copy | double-tap: cut.
ZMK_TAP_DANCE(copy_cut, bindings = <&kp LC(INS)>, <&kp LC(X)>;
              tapping-term-ms = <200>;)

// Sticky shift + leader.
ZMK_MACRO(leader_sft, bindings = <&sk LSHFT &leader>;)

// Misc aliases. [TODO: clean up]
#define CANCEL    &kp K_CANCEL            // Cancel caps-word & auto-layers.
#define DSK_PREV  &hmr LCTRL LG(LC(LEFT)) // Previous desktop.
#define DSK_NEXT  &hmr LALT LG(LC(RIGHT)) // Next     desktop.
#define PIN_WIN   &kp LG(LC(LS(Q)))       // Pin window across desktops.
#define PIN_APP   &kp LG(LC(LS(A)))       // Pin application across desktops.
#define DSK_MGR   &kp LA(GRAVE)           // Desktop manager.
#define VOL_DOWN  &hmr RSHFT C_VOL_DN

/* Keymap */

// ZMK_CONDITIONAL_LAYER(sys, FN NUM, SYS) // FN + NUM --> SYS.

#ifndef ZMK_BASE_LAYER
  #define ZMK_BASE_LAYER(name, LT, RT, LM, RM, LB, RB, LH, RH)                 \
      ZMK_LAYER(name, LT RT LM RM LB RB LH RH)
#endif

&uc {
  default-mode = <UC_MODE_LINUX>;
};

// Swapper for smart alt+esc
ZMK_TRI_STATE(la_esc, bindings = <&kt LALT>, <&kp ESC>, <&kt LALT>;
              ignored-key-positions = <LT5>;) // itself only
/ { behaviors {
    // Swapper for smart ctrl+tab
    ctrl_tab: ctrl_tab {
        compatible = "zmk,behavior-smart-toggle";
        #binding-cells = <0>;
        bindings = <&kp LCTRL>, <&kp TAB>;
        ignored-key-positions = <LT3 RT2 RM1 RM2 RM3 RB1 RB3>; // itself and arrows and tabs
    };
    // Swapper for smart ctrl+shift+tab
    ctrl_ptab: ctrl_ptab {
        compatible = "zmk,behavior-smart-toggle";
        #binding-cells = <0>;
        bindings = <&kp LCTRL>, <&kp LS(TAB)>;
        ignored-key-positions = <LT4 RT2 RM1 RM2 RM3 RB1 RB3>; // itself and arrows and tabs
    };
}; };

ZMK_BASE_LAYER(Base,
//╭─────────────┬─────────────┬─────────────┬─────────────┬─────────────╮ ╭─────────────┬─────────────┬─────────────┬─────────────┬─────────────╮
    &kp SQT       &kp COMMA     &kp DOT       &kp P         &kp Y       ,   &kp F         &kp G         &kp C         &kp R         &kp L       ,
//├─────────────┼─────────────┼─────────────┼─────────────┼─────────────┤ ├─────────────┼─────────────┼─────────────┼─────────────┼─────────────┤
    &hml LGUI A   &hml LALT O   &hml LCTRL E  &hml LSHFT U  &kp I       ,   &kp D         &hmr RSHFT H  &hmr LCTRL T  &hmr LALT N   &hmr LGUI S ,
//├─────────────┼─────────────┼─────────────┼─────────────┼─────────────┤ ├─────────────┼─────────────┼─────────────┼─────────────┼─────────────┤
    &kp SEMI      &kp Q         &kp J         &kp K         &kp X       ,   &kp B         &kp M         &kp W         &kp V         &kp Z       ,
//╰─────────────┴─────────────┼─────────────┼─────────────┼─────────────┤ ├─────────────┼─────────────┼─────────────┼─────────────┴─────────────╯
                              &lt VIM_NAV ESC &lt_spc NAV 0 &lt NUM RET ,   &lt FN RET    &lt SYM BSPC  &lt FN DEL
//                            ╰─────────────┴─────────────┴─────────────╯ ╰─────────────┴─────────────┴─────────────╯
)

// TODO: &lt to &sm
#define NAV_CUT    &hml LGUI LC(X)
#define NAV_COPY   &hml LALT LC(C)
#define NAV_PASTE  &hml LCTRL LC(V)
#define NAV_UNDO   &hml LSHIFT LC(Z)
#define REDO       &kp LS(LC(Z))
#define SELECT_ALL &kp LC(A)
#define TERM_COPY  &kp LS(LC(C))
#define TERM_PASTE &kp LS(LC(V))
#define VIM_WIN    &kp LC(W)
#define SAVE       &kp LC(S)

ZMK_BASE_LAYER(Nav,
// TODO: add LG(L) to LH4

//╭─────────────┬─────────────┬─────────────┬─────────────┬─*───────────╮ ╭─────────────┬─*───────────┬─────────────┬─*───────────┬─*───────────╮
    &la_esc       &ctrl_ptab    &ctrl_tab     &kp F5        &swapper    ,   &kp PG_UP     NAV_BSPC      NAV_UP        NAV_DEL       &kp PG_DN   ,
//├─────────────┼─────────────┼─────────────┼─────────────┼─────────────┤ ├─*───────────┼─────────────┼─────────────┼─────────────┼─────────────┤
    NAV_CUT       NAV_COPY      NAV_PASTE     NAV_UNDO      VIM_WIN     ,   &kp PG_DN     NAV_LEFT      NAV_DOWN      NAV_RIGHT     &kp RET     ,
//├─────────────┼─────────────┼─────────────┼─────────────┼─────────────┤ ├─────────────┼─────────────┼─────────────┼─────────────┼─────────────┤
    SELECT_ALL    TERM_COPY     TERM_PASTE    REDO          SAVE        ,   &kp INS       &kp LS(TAB)   &kp K_APP     &kp TAB       ___         ,
//╰─────────────┴─────────────┼─────────────┼─────────────┼─────────────┤ ├─────────────┼─────────────┼─────────────┼─────────────┴─────────────╯
                                &kp PSCRN     XXX           &bootloader ,   ___           CANCEL        ___
//                            ╰─────────────┴─────────────┴─────────────╯ ╰─────────────┴─────────────┴─────────────╯
)

ZMK_BASE_LAYER(Fn,
//╭─────────────┬─────────────┬─────────────┬─────────────┬─────────────╮ ╭─────────────┬─────────────┬─────────────┬─────────────┬─────────────╮
                               _BT_SEL_KEYS_                            ,   &kp LA(F4)    &kp F7        &kp F8        &kp F9        &kp F10     ,
//├─────────────┼─────────────┼─────────────┼─────────────┼─────────────┤ ├─────────────┼─────────────┼─────────────┼─────────────┼─────────────┤
    &kp LGUI      &kp LALT      &kp LCTRL     &kp LSHIFT    &bootloader ,   &kp PSCRN     &kp F4        &kp F5        &kp F6        &kp F11     ,
//├─────────────┼─────────────┼─────────────┼─────────────┼─────────────┤ ├─────────────┼─────────────┼─────────────┼─────────────┼─────────────┤
    XXX           XXX           XXX           XXX           &sys_reset  ,   &kp LS(PSCRN) &kp F1        &kp F2        &kp F3        &kp F12     ,
//╰─────────────┴─────────────┼─────────────┼─────────────┼─────────────┤ ├─────────────┼─────────────┼─────────────┼─────────────┴─────────────╯
                                ___           &sys_reset    &bootloader ,   &bootloader   &sys_reset    XXX
//                            ╰─────────────┴─────────────┴─────────────╯ ╰─────────────┴─────────────┴─────────────╯
)

ZMK_BASE_LAYER(Num,
// TODO:
// &curr_euro
// &kp u_BACK    &kp u_FWD     &kp F5        &kp F12
// U_DEVTOG
// &kp K_CALC
// sensor-bindings = <&inc_dec_kp u_TAB_PRV u_TAB_NXT &inc_dec_kp LS(TAB) TAB>;

//╭─────────────┬─────────────┬─────────────┬─────────────┬─────────────╮ ╭─────────────┬─────────────┬─────────────┬─────────────┬─────────────╮
    ___           ___           ___           ___           ___         ,   XXX           &kp N7        &kp N8        &kp N9        &kp COLON   , // &kp KP_DIVIDE,
//├─────────────┼─────────────┼─────────────┼─────────────┼─────────────┤ ├─────────────┼─────────────┼─────────────┼─────────────┼─────────────┤
    &kp LGUI      &kp LALT      &kp LCTRL     &kp LSHIFT    ___         ,   &kp PLUS      &kp N4        &kp N5        &kp N6        &kp DOT     , // &kp KP_MINUS,
//├─────────────┼─────────────┼─────────────┼─────────────┼─────────────┤ ├─────────────┼─────────────┼─────────────┼─────────────┼─────────────┤
    ___           ___           ___           ___           ___         ,   &kp STAR      &kp N1        &kp N2        &kp N3        &curr_euro  , // &kp DE_COMMA,
//╰─────────────┴─────────────┼─────────────┼─────────────┼─────────────┤ ├─────────────┼─────────────┼─────────────┼─────────────┴─────────────╯
                                ___           ___           ___         ,   &kp BSPC      &kp N0        &kp DEL
//                            ╰─────────────┴─────────────┴─────────────╯ ╰─────────────┴─────────────┴─────────────╯
)

// TODO: remove
// ~@*&\   ^<>/%      combos:     `  $      |         {  }
// €:-+    !()"?
// ;10|    #[]'_      combos:  ra ra -> =>  |  ` = $` =  ra ra
// 
// `12345 67890-= 
// ~!@#$% ^&*()_+
// `12345 67890= 
// ~!@#$% ^&*()_+
// []  {}  
// ;'\ :"| 
// ,./ <>? 
ZMK_BASE_LAYER(Symbols,
//╭──── ~ ──────┬──── @ ──────┬──── * ──────┬──── & ──────┬──── \ ──────╮ ╭──── ^ ──────┬──── < ──────┬──── > ──────┬─ / ─────────┬─ % ─────────╮
    &kp TILDE     &kp AT        &kp STAR      &kp AMPS      &kp BSLH    ,   &kp CARET     &kp LT        &kp GT        &kp FSLH      &kp PRCNT   ,
//╭──── € ──────┬──── : ──────┬──── - ──────┬──── + ──────┬─────────────┤ ├──── ! ──────┬──── ( ──────┬──── ) ──────┬──── " ──────┬──── ? ──────╮
    &curr_euro    &kp COLON     &kp MINUS     &kp PLUS      XXX         ,   &kp EXCL      &kp LPAR      &kp RPAR      &kp DQT       &kp QMARK   ,
//╭──── ; ──────┬──── 1 ──────┬──── 0 ──────┬──── | ──────┬─────────────┤ ├──── # ──────┬──── [ ──────┬──── ] ──────┬──── ' ──────┬──── _ ──────╮
    &kp SEMI      &kp N1        &kp N0        &kp PIPE      XXX         ,   &kp HASH      &kp LBKT      &kp RBKT      &kp SQT       &kp UNDER   ,
//╰─────────────┴─────────────┼─────────────┼─────────────┼─────────────┤ ├─────────────┼─────────────┼─────────────┼─────────────┴─────────────╯
                                ___           ___           ___         ,   ___           ___           ___
//                            ╰─────────────┴─────────────┴─────────────╯ ╰─────────────┴─────────────┴─────────────╯
)

ZMK_BASE_LAYER(Mouse,
//╭─────────────┬─────────────┬─────────────┬─────────────┬─────────────╮ ╭─────────────┬─────────────┬─────────────┬─────────────┬─────────────╮
    ___           ___           ___           ___           ___         ,   ___           &kp PG_UP     U_MS_U        &kp PG_DN     ___         ,
//├─────────────┼─────────────┼─────────────┼─────────────┼─────────────┤ ├─────────────┼─────────────┼─────────────┼─────────────┼─────────────┤
    ___           ___           ___           ___           ___         ,   U_WH_L        U_MS_L        U_MS_D        U_MS_R        U_WH_R      ,
//├─────────────┼─────────────┼─────────────┼─────────────┼─────────────┤ ├─────────────┼─────────────┼─────────────┼─────────────┼─────────────┤
    ___           ___           ___           ___           ___         ,   ___           &mkp LCLK     &mkp MCLK     &mkp RCLK     ___         ,
//╰─────────────┴─────────────┼─────────────┼─────────────┼─────────────┤ ├─────────────┼─────────────┼─────────────┼─────────────┴─────────────╯
                                ___           ___           ___         ,   U_WH_U        U_WH_D        ___
//                            ╰─────────────┴─────────────┴─────────────╯ ╰─────────────┴─────────────┴─────────────╯
)

// &kp TILDE     &kp AT        &kp STAR      &kp AMPS      &kp BSLH                                                                      &kp CARET     &kp LT        &kp GT        &kp FSLH      &kp PRCNT     &kp BSPC
// &kp DE_EURO   &kp COLON     &kp MINUS     &kp PLUS      XXX                                                                           &kp EXCL      &kp LPAR      &kp RPAR      &kp DQT       &kp QMARK     XXX
// &kp SEMI      &kp N1        &kp N0        &kp PIPE      XXX           XXX                                               XXX           &kp HASH      &kp LBKT      &kp RBKT      &kp SQT       &kp UNDER     XXX
// LAR_2         LAR_3                       L_ENC         &kp BSPC      &kp LTK_2 &kp BSPC                  XXX           ___           XXX           R_ENC                       XXX           XXX           XXX
// COMBO( 8,  9, RBKT )
// COMBO( 7,  8, LBKT )

// #define INSERT          &kp I
// #define APPEND          &kp A
// #define HOME_LINE       &kp LS(H)
// #define MIDDLE_LINE     &kp LS(M)
// #define LAST_LINE       &kp LS(L)
//
// Vim navigation
// left hand
#define TAB_PREV        &m_gt2
#define TAB_NEXT        &m_gt1
ZMK_MACRO(m_gt2,  bindings = <&kp G  &kp LS(T)>;  wait-ms = <0>; tap-ms = <5>;)
ZMK_MACRO(m_gt1,  bindings = <&kp G  &kp    T >;  wait-ms = <0>; tap-ms = <5>;)
#define CMD             &kp COLON
#define JUMP_FORW       &kp    F
#define JUMP_BACK       &kp LS(F)
#define JUMP_FORW_T     &kp    T
#define JUMP_BACK_T     &kp LS(T)

// right hand
#define LINE_START      &kp N0
#define LINE_END        &kp DOLLAR
#define FIRST_CHAR      &kp CARET
#define LAST_CHAR       &m_g_
#define PREV_WORD       &kp B
#define NEXT_WORD       &kp W
#define PREV_WORD_E     &m_ge
#define NEXT_WORD_E     &kp E
// multiple chars
ZMK_MACRO(m_g_,  bindings = <&kp G  &kp UNDER>;  wait-ms = <0>; tap-ms = <5>;)
ZMK_MACRO(m_ge,  bindings = <&kp G  &kp E>;      wait-ms = <0>; tap-ms = <5>;)
#define LINE_UP         &kp MINUS
#define LINE_DN         &kp PLUS
#define PREV_FIND       &mt HASH LS(N)  // Tap: N  | Long-tap: #
#define NEXT_FIND       &mt STAR N      // Tap: n  | Long-tap: *
#define SEARCH          &kp SLASH
#define REPEAT          &kp DOT
#define I_ONE_SHOT      &kp LC(O)

ZMK_BASE_LAYER(Vim_Navigation,
//╭─────────────┬─ gT ────────┬── gt ───────┬─────────────┬─────────────╮ ╭─ 0 ─────────┬─ ^ ─────────┬─ - ─────────┬─ g_ ────────┬─ $ ─────────╮
    ___           TAB_PREV      TAB_NEXT      ___           ___         ,   LINE_START    FIRST_CHAR    LINE_UP       LAST_CHAR     LINE_END    ,
//├─ : ─────────┼─────────────┼─────────────┼─────────────┼─────────────┤ ├─ b ─────────┼─ ge ────────┼─ + ─────────┼─ w ─────────┼─ e ─────────┤
    CMD           &mo VIM_RS    &mo VIM_WS    &mo VIM_PS    ___         ,   PREV_WORD     PREV_WORD_E   LINE_DN       NEXT_WORD     NEXT_WORD_E ,
//├─ T ─────────┼─ F ─────────┼─ f ─────────┼─ t ─────────┼─────────────┤ ├─────────────┼─ N # ───────┼─ / ─────────┼─ n * ───────┼─────────────┤
    JUMP_BACK_T   JUMP_BACK     JUMP_FORW     JUMP_FORW_T   ___         ,   ___           PREV_FIND     SEARCH        NEXT_FIND     ___         ,
//╰─────────────┴─────────────┼─────────────┼─────────────┼─────────────┤ ├─ . ─────────┼─────────────┼─  ────────┼─────────────┴─────────────╯
                                ___           ___           ___         ,   REPEAT                      I_ONE_SHOT
//                            ╰─────────────┴─────────────┴─────────────╯ ╰─────────────┴─────────────┴─────────────╯
)

// hjkl navigation
#define VIM_UP       &kp H
#define VIM_DOWN     &kp J
#define VIM_LEFT     &kp K
#define VIM_RIGHT    &kp L

ZMK_BASE_LAYER(Vim_HJKL_Navigation,
//╭─────────────┬─────────────┬─────────────┬─────────────┬─────────────╮ ╭─────────────┬─────────────┬─────────────┬─────────────┬─────────────╮
    ___           ___           ___           ___           ___         ,   ___           ___           VIM_UP        ___           ___         ,
//├─────────────┼─────────────┼─────────────┼─────────────┼─────────────┤ ├─────────────┼─────────────┼─────────────┼─────────────┼─────────────┤
    &kp LGUI      &kp LALT      &kp LCTRL     &kp LSHIFT    ___         ,   ___           VIM_LEFT      VIM_DOWN      VIM_RIGHT     ___         ,
//├─────────────┼─────────────┼─────────────┼─────────────┼─────────────┤ ├─────────────┼─────────────┼─────────────┼─────────────┼─────────────┤
    ___           ___           ___           ___           ___         ,   ___           ___           ___           ___           ___         ,
//╰─────────────┴─────────────┼─────────────┼─────────────┼─────────────┤ ├─────────────┼─────────────┼─────────────┼─────────────┴─────────────╯
                                ___           ___           ___         ,   ___           ___           ___
//                            ╰─────────────┴─────────────┴─────────────╯ ╰─────────────┴─────────────┴─────────────╯
)

// window switching
ZMK_MACRO(ws_up   , bindings = <&kp LC(W) &kp K>; wait-ms = <0>; tap-ms = <5>;)
ZMK_MACRO(ws_down , bindings = <&kp LC(W) &kp J>; wait-ms = <0>; tap-ms = <5>;)
ZMK_MACRO(ws_left , bindings = <&kp LC(W) &kp H>; wait-ms = <0>; tap-ms = <5>;)
ZMK_MACRO(ws_right, bindings = <&kp LC(W) &kp L>; wait-ms = <0>; tap-ms = <5>;)

ZMK_BASE_LAYER(Vim_Window_Switch,
//╭─────────────┬─────────────┬─────────────┬─────────────┬─────────────╮ ╭─────────────┬─────────────┬─────────────┬─────────────┬─────────────╮
    ___           ___           ___           ___           ___         ,   ___           ___           &ws_up        ___           ___         ,
//├─────────────┼─────────────┼─────────────┼─────────────┼─────────────┤ ├─────────────┼─────────────┼─────────────┼─────────────┼─────────────┤
    ___           ___           ___           ___           ___         ,   ___           &ws_left      &ws_down      &ws_right     ___         ,
//├─────────────┼─────────────┼─────────────┼─────────────┼─────────────┤ ├─────────────┼─────────────┼─────────────┼─────────────┼─────────────┤
    ___           ___           ___           ___           ___         ,   ___           ___           ___           ___           ___         ,
//╰─────────────┴─────────────┼─────────────┼─────────────┼─────────────┤ ├─────────────┼─────────────┼─────────────┼─────────────┴─────────────╯
                                ___           ___           ___         ,   ___           ___           ___
//                            ╰─────────────┴─────────────┴─────────────╯ ╰─────────────┴─────────────┴─────────────╯
)

// results scrolling
#define RS_UP       &kp PG_UP
#define RS_DOWN     &kp PG_DN
#define RS_LEFT     &kp LA(F)
#define RS_RIGHT    &kp LA(K)

ZMK_BASE_LAYER(Vim_Results_Scroll,
//╭─────────────┬─────────────┬─────────────┬─────────────┬─────────────╮ ╭─────────────┬─────────────┬─────────────┬─────────────┬─────────────╮
    ___           ___           ___           ___           ___         ,   ___           ___           RS_UP         ___           ___         ,
//├─────────────┼─────────────┼─────────────┼─────────────┼─────────────┤ ├─────────────┼─────────────┼─────────────┼─────────────┼─────────────┤
    ___           ___           ___           ___           ___         ,   ___           RS_LEFT       RS_DOWN       RS_RIGHT      ___         ,
//├─────────────┼─────────────┼─────────────┼─────────────┼─────────────┤ ├─────────────┼─────────────┼─────────────┼─────────────┼─────────────┤
    ___           ___           ___           ___           ___         ,   ___           ___           ___           ___           ___         ,
//╰─────────────┴─────────────┼─────────────┼─────────────┼─────────────┤ ├─────────────┼─────────────┼─────────────┼─────────────┴─────────────╯
                                ___           ___           ___         ,   ___           ___           ___
//                            ╰─────────────┴─────────────┴─────────────╯ ╰─────────────┴─────────────┴─────────────╯
)

// preview scrolling
#define PS_UP       &kp LC(U)
#define PS_DOWN     &kp LC(D)
#define PS_LEFT     &kp LC(F)
#define PS_RIGHT    &kp LC(K)

ZMK_BASE_LAYER(Vim_Preview_Scroll,
//╭─────────────┬─────────────┬─────────────┬─────────────┬─────────────╮ ╭─────────────┬─────────────┬─────────────┬─────────────┬─────────────╮
    ___           ___           ___           ___           ___         ,   ___           ___           PS_UP         ___           ___         ,
//├─────────────┼─────────────┼─────────────┼─────────────┼─────────────┤ ├─────────────┼─────────────┼─────────────┼─────────────┼─────────────┤
    ___           ___           ___           ___           ___         ,   ___           PS_LEFT       PS_DOWN        PS_RIGHT     ___         ,
//├─────────────┼─────────────┼─────────────┼─────────────┼─────────────┤ ├─────────────┼─────────────┼─────────────┼─────────────┼─────────────┤
    ___           ___           ___           ___           ___         ,   ___           ___           ___           ___           ___         ,
//╰─────────────┴─────────────┼─────────────┼─────────────┼─────────────┤ ├─────────────┼─────────────┼─────────────┼─────────────┴─────────────╯
                                ___           ___           ___         ,   ___           ___           ___
//                            ╰─────────────┴─────────────┴─────────────╯ ╰─────────────┴─────────────┴─────────────╯
)

/* vim: set nowrap ft=c foldmethod=marker foldmarker=(,) tw=146: */
