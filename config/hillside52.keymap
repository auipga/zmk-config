/* https://github.com/urob/zmk-helpers/blob/main/include/zmk-helpers/key-labels/hillside52.h */
/*                                      52 KEY MATRIX / LAYOUT MAPPING

  ╭────────────────────────╮               ╭────────────────────────╮
  │  0   1   2   3   4   5 │               │  6   7   8   9  10  11 │
  │ 12  13  14  15  16  17 ╰──╮         ╭──╯ 18  19  20  21  22  23 │
  │ 24  25  26  27  28  29  30╰────┬────╯31  32  33  34  35  36  37 │
  │ 38  39  40      41  42  43  44 │ 45  46  47  48      49  50  51 │
  ╰────────────────────────────────┴────────────────────────────────╯
 ╭─────────────────────────╮               ╭─────────────────────────╮
 │ LT5 LT4 LT3 LT2 LT1 LT0 │               │ RT0 RT1 RT2 RT3 RT4 RT5 │
 │ LM5 LM4 LM3 LM2 LM1 LM0 ╰──╮         ╭──╯ RM0 RM1 RM2 RM3 RM4 RM5 │
 │ LB5 LB4 LB3 LB2 LB1 LB0 LH4╰────┬────╯RH4 RB0 RB1 RB2 RB3 RB4 RB5 │
 │ LP2 LP1 LP0╭───╮LEC LH2 LH1 LH0 │ RH0 RH1 RH2 REC╭───╮RP0 RP1 RP2 │
 ╰────────────╯   ╰────────────────┴────────────────╯   ╰────────────╯
 T : Top
 M : Middle
 B : Bottom
 H : Hand
 P : Palm
*/


// &kp K_PREV    &kp K_NEXT
// &out OUT_USB  &bt BT_CLR    &out OUT_BLE &bt BT_SEL 2
//
#define ZMK_BASE_LAYER(name, LT, RT, LM, RM, LB, RB, LH, RH)                             \
    ZMK_LAYER_3(                                                                         \
        name,                                                                            \
        &kp ESC                  LT                RT                    &kp SLASH  \
        &none                    LM                RM                    &kp MINUS  \
        &none                    LB &pass    &none RB                    &bt BT_NXT \
        &none &none &none  XXX   LH                RH   XXX  &kp LEFT &kp SPACE &kp RIGHT,  \
        &inc_dec_kp C_VOL_DN C_VOL_UP &inc_dec_kp PG_UP PG_DN \
    )

#include "zmk-helpers/key-labels/hillside52.h"
#include "base-auipga.keymap"
#include "_private.dtsi"

/* vim: set nowrap ft=c foldmethod=marker foldmarker=(,) tw=146: */
